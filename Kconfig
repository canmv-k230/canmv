## Kconfig
```kconfig
menuconfig SDK_ENABLE_CANMV
    bool "CanMV Components Configuration"
    default n

    if SDK_ENABLE_CANMV
        config ENABLE_NETWORK_RT_LAN
            bool "Enable Network RT-Thread Lan(eth)"
            default y

        config ENABLE_NETWORK_RT_WLAN
            bool "Enable Network RT-Thread Wlan"
            default y
        
        config ENABLE_TOUCH_DRIVER_CST_MUTCAP
            bool "Enable Touch Driver for cstxxx(mut cap)"
            default y
            help
                CST128, CST328, CST226SE and others

        config ENABLE_TOUCH_DRIVER_GT911
            bool "Enable Touch Driver for gt911"
            default y
    endif
```
